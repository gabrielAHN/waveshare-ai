/* Offline generator: renders a real frame of the device's own sparkle renderer
 * (water + a held touch cluster + trail births) and writes a rounded 192x192
 * RGB565+alpha image for the Home "Sparkles" page:
 * Use the named-device firmware include and qrcodegen paths, plus both shared plugin firmware paths.
 * Output: plugins/hermes/firmware/sparkle_image.h (+ evidence/sparkle-image.ppm preview). */
#include <stdio.h>
#include "home_render.h"
#define IMG 192
static uint16_t frame[SPARKLES_PIXELS];
int main(int argc,char**argv){
 int hold=argc>1?atoi(argv[1]):70,dens=argc>2?atoi(argv[2]):3;
 home_ui s={0};s.page=SPARKLES;s.session_off=true;
 home_sample(&s,1000000,false,0,0);
 /* A held press in the middle with a small organic wander, like a real finger. */
 for(int i=1;i<=hold;i++){
  unsigned x=184+(unsigned)(6.f*sinf(i*.05f)),y=224+(unsigned)(5.f*cosf(i*.07f));
  home_sample(&s,1000000+i*10000,true,x,y);
 }
 sparkles_state scene=s.input.scene;scene.theme=0;scene.density=dens;scene.quiet=dens==0;
 if(!sparkles_render_direct(&scene,frame,SPARKLES_PIXELS))return 1;
 const int ox=184-IMG/2,oy=224-IMG/2;const float R=IMG/2.f,corner=44.f;
 FILE*h=fopen("plugins/hermes/firmware/sparkle_image.h","w"),*pp=fopen("evidence/sparkle-image.ppm","wb");
 if(!h||!pp)return 1;
 fprintf(h,"/* Generated by tools/build_sparkle_image.c from the device's own sparkles.h renderer\n"
          " * (held touch cluster + water). plain RGB565 (sp_pack_lcd order) + 8-bit rounded-rect alpha. */\n"
          "#pragma once\n#include <stdint.h>\n#define SPARKLE_IMAGE_SIZE %d\n",IMG);
 fprintf(pp,"P6\n%d %d\n255\n",IMG,IMG);
 fprintf(h,"static const uint16_t sparkle_image_rgb[SPARKLE_IMAGE_SIZE*SPARKLE_IMAGE_SIZE]={\n");
 for(int y=0;y<IMG;y++){for(int x=0;x<IMG;x++){uint16_t v=frame[(oy+y)*SPARKLES_W+ox+x];fprintf(h,"%u,",v);
   uint16_t l=v;fputc((l>>11)*255/31,pp);fputc(((l>>5)&63)*255/63,pp);fputc((l&31)*255/31,pp);}
  fputc('\n',h);}
 fprintf(h,"};\nstatic const uint8_t sparkle_image_alpha[SPARKLE_IMAGE_SIZE*SPARKLE_IMAGE_SIZE]={\n");
 for(int y=0;y<IMG;y++){for(int x=0;x<IMG;x++){
   /* Rounded square, 1px antialiased edge. */
   float dx=fabsf(x+.5f-R)-(R-corner),dy=fabsf(y+.5f-R)-(R-corner);
   float d=(dx>0||dy>0)?sqrtf(fmaxf(dx,0)*fmaxf(dx,0)+fmaxf(dy,0)*fmaxf(dy,0))-corner:fmaxf(dx,dy)-corner;
   float a=sp_clamp(.5f-d,0,1);fprintf(h,"%u,",(unsigned)(a*255+.5f));}
  fputc('\n',h);}
 fprintf(h,"};\n");fclose(h);fclose(pp);
 puts("sparkle_image.h written from the real renderer");
 return 0;
}
